## src/ca-in-the-loop/kernel_huawei_p9_lite/arch/arm64/configs/eng_defconfig/hi6250/hisi_debug_defconfig
```kconfig
CONFIG_KPROBES=y
CONFIG_HAVE_KPROBES=y
CONFIG_KRETPROBES=y
CONFIG_HAVE_KRETPROBES=y
CONFIG_HISILICON_FREQDUMP=y
```
